## components/wifi_manager/Kconfig.projbuild
```kconfig
menu "WiFi Configuration"

    config ESP_WIFI_SSID
        string "WiFi SSID"
        default "myssid"
        help
            SSID (network name) for the ESP32 to connect to.

    config ESP_WIFI_PASSWORD
        string "WiFi Password"
        default "mypassword"
        help
            WiFi password (WPA2 PSK) for the ESP32.

    config ESP_MAXIMUM_RETRY
        int "Maximum retry attempts"
        default 5
        help
            Set the Maximum retry to avoid station reconnecting to the AP forever when
            the AP is not found. After this amount of retries, it will retry every 5 seconds.

endmenu
```

## sdkconfig.defaults
```kconfig
# Configure Flash Size to 4MB (Removes "Detected size larger than binary" warning)
CONFIG_ESPTOOLPY_FLASHSIZE_4MB=y

# Support BOYA Flash Chip (Removes "using generic driver" warning)
CONFIG_SPI_FLASH_SUPPORT_BOYA_CHIP=y

# Disable Automatic Task Watchdog Initialization (Removes TWDT init error log)
# We manually initialize it in main.c, so we don't need the system to do it twice.
CONFIG_ESP_TASK_WDT_INIT=n
```
